## drivers/misc/netmux/Kconfig
```kconfig
#
# Netmux configuration
#

menu "Motorola netmux driver"

config NETMUX_DRIVER
        tristate "Motorola netmux driver"
        default m

config DEBUG_NETMUX
        bool "Builds netmux proc logging Interface"
        default n

config NETMUX_LINKDRIVER_SOFTERROR
        boolean "Turn panics in the linkdriver to printks"
        default n

endmenu
```
